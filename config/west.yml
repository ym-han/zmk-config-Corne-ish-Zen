## config/west.yml
```yaml
manifest:
  remotes:
    - name: LOWPROKB
      url-base: https://github.com/LOWPROKB
    - name: stites
      url-base: https://github.com/stites
  projects:
    - name: zmk
      remote: stites
      revision: zen-on-main+969+plover-hid
      import: app/west.yml
  self:
    path: config
```
